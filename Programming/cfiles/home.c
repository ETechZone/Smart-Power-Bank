/* 
************************* C file for OLED display*****************************
*/
//
//##############################################################
//       File Name : home.c
//       
//       TITLE     : Sh1106 oled with c2000(F28027)
//       
//       Development Kit : LAUNCHXL F28027
// 
//       Date Of Created : 16/05/2019 
//###############################################################
//
// Included Files
//
#include<home.h>
#include<icon.h>
#include "Sh1106_Oled.h"
struct Home_parameters home_ptr;
//
//*********************************************************************************************
//Function Name    : void Update_logo(unsigned int page, unsigned int coloumn, unsigned char logo)
//No.Of Parameters : 3
//Parameters Type  : unsigned int, unsigned int, unsigned char
//Return Type      : void
//Description      : To draw the logo based on the input parameters(i.e. x and y)
//**********************************************************************************************
//
void Update_logo(unsigned int page, unsigned int coloumn, unsigned char logo){
unsigned int i=0;
unsigned char j,k;
unsigned char logo_str[3][32]={
{ //  index position 0  contain the AC bitmap
 0xFF, 0xFF, 0xFF, 0xFF, 0x0F, 0x0F, 0xFF, 0xFF,
 0xFF, 0xFF, 0x0F, 0x0F, 0xFF, 0xFF, 0xFF, 0xFF,
 0xFF, 0xFF, 0xFF, 0xFF, 0xFE, 0xFE, 0xC3, 0xC3,
 0xC3, 0xC3, 0xFE, 0xFE, 0xFF, 0xFF, 0xFF, 0xFF
 },
 {//  index position 1  contain the  HUB bitmap
 0xFF, 0x7F, 0x9F, 0XEF, 0xEF, 0xEF, 0xEF, 0xEF,
 0xEF, 0x9F, 0x7F, 0x7F, 0x7F, 0xFF, 0xFF, 0xFF,
 0xF8, 0xF7, 0xCF, 0xDF, 0xDF, 0xDF, 0xDF, 0xDF,
 0xDF, 0xDF, 0xDF, 0xDF, 0xDF, 0xCE, 0xEE, 0xF1
 },
{ //  index position 1  contain the  CB bitmap
  0xFF, 0x7F, 0xBF, 0xDF, 0xEF, 0x2F, 0x4F, 0x7F,
  0xFF, 0xFF, 0x7F, 0xBF, 0xDF, 0xBF, 0x7F, 0xFF,
  0xFC, 0xCD, 0xD1, 0xEF, 0xF7, 0xFB, 0xFD, 0xFE,
  0xFF, 0xFE, 0xE0, 0xEF, 0xEF, 0xEF, 0xE0, 0xFE
}
};
// 0 for AC
// 1 for CB
// 2 for HUB
i=128*page+coloumn;
for(j=0;j<2;j++){
    for(k=0;k<16;k++,i++){
        Current_Screen[i]=logo_str[logo][k+j*16];
    }
    i=i+112;
}
}
//
//*********************************************************************************************
//Function Name    : void Top_line_Update(unsigned int page, unsigned int coloumn, unsigned int num)
//No.Of Parameters : 3
//Parameters Type  : unsigned int, unsigned int, unsigned int
//Return Type      : void
//Description      : To draw the numerics based on the input parameters(i.e. x and y)
//**********************************************************************************************
//
void Top_line_Update(unsigned int page, unsigned int coloumn, unsigned int num){
  unsigned int i,k=0;
unsigned char numeric[][4]={
{0xC1, 0xAE, 0xB6, 0xC1},//0
{0xFB, 0xBD, 0x80, 0xBF},//1
{0x9D, 0xAE, 0xB6, 0xB9},//2
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{0xD9, 0xB6, 0xB6, 0xC1},//9
};
i=128*page+coloumn;
for(k=0;k<4;k++,i++){
        Current_Screen[i]=numeric[num][k];
    }
}
//
//*********************************************************************************************
//Function Name    : void bottom_line_Update(unsigned int page, unsigned int coloumn, unsigned int num)
//No.Of Parameters : 3
//Parameters Type  : unsigned int, unsigned int, unsigned int
//Return Type      : void
//Description      : To draw the numerics based on the input parameters(i.e. x and y)
//**********************************************************************************************
//
void bottom_line_Update( unsigned int coloumn, unsigned int num){
  unsigned int i,j,k=0;
unsigned char numeric[][4]={
{0xC1, 0xAE, 0xB6, 0xC1},//0
{0xFB, 0xBD, 0x80, 0xBF},//1
{0x9D, 0xAE, 0xB6, 0xB9},//2
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{0xD9, 0xB6, 0xB6, 0xC1},//9
};
i=128*6+coloumn;
for(k=0;k<4;k++,i++){
       j=numeric[num][k]<<6;
       j=j|0x3F;
        Current_Screen[i]=j & Current_Screen[i] ;

    }
i=128*7+coloumn;
for(k=0;k<4;k++,i++){
       j=numeric[num][k]>>2;
       j=j|0xC0;
        Current_Screen[i]=j & Current_Screen[i] ;
    }
}
void Home_var_intial_update(){
      home_ptr.minutes=90;
      home_ptr.watt_hour=70000;
      home_ptr.percentage=95;
      home_ptr.temp=27.72;
      home_ptr.in_watt=0;
      home_ptr.out_watt=61;
}
//
//*********************************************************************************************
//Function Name    : Uint8* Home_draw()
//No.Of Parameters : 0
//Parameters Type  : void
//Return Type      : Uint8*
//Description      : To draw the entire home screen
//**********************************************************************************************
//
Uint8* Home_draw(){
    unsigned int i;
    const Uint8 Oledx[]={
                         0xFF, 0xFF, 0xFF, 0xFF, 0xFF, 0xFF, 0xFF, 0x7F, 0xBF, 0xBF, 0xDF, 0x5F, 0xDF, 0xDF, 0xBF, 0xBF,
                         0x7F, 0xFF, 0xFF, 0xFF, 0xFF, 0xFF, 0xFF, 0xFF, 0xFF, 0xFF, 0xFF, 0xFF, 0xFF, 0xFF, 0xFF, 0xFF,
                         0xFF, 0xFF, 0xFF, 0xFF, 0xFF, 0xFF, 0xFF, 0xFF, 0xFF, 0xFF, 0xFF, 0xFF, 0xFF, 0xFF, 0xFF, 0xFF,
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                         0xFF, 0xFF, 0xFF, 0xFF, 0xFF, 0xFF, 0xFF, 0xFF, 0xFF, 0xFF, 0xFF, 0xFF, 0xFF, 0xFF, 0xFF, 0xFF
    };
        for(i=0;i<1024;i++){
           Current_Screen[i]=Oledx[i] ;
        }

        Home_var1(home_ptr.minutes);
        Home_var2(home_ptr.watt_hour);
        Home_var3(home_ptr.percentage);
        Home_var4(home_ptr.percentage);
        Home_var5(home_ptr.in_watt);
        Home_var6(home_ptr.out_watt);
        Home_var7(home_ptr.temp);

        //if((Icon_Read_Status()&0x01)==0x01)
       // Update_logo(2,38,0);
       // if((Icon_Read_Status()&0x02)==0x02)
        Update_logo(2,65,1);

        //Update_logo(2,96,2);
        Current_Screen_ptr=&Current_Screen[0];
    return Current_Screen_ptr;
}
//new
//
//
void Update_battry_percent(int i,int k){
    int j=0;
    i=i+128*2;
    for(j=i;j<i+7;j++){
        if(k==0)
        Current_Screen[j]=0xFF;
        else
        Current_Screen[j]=0x00;
    }
    i=i+128;
    for(j=i;j<i+7;j++){
        if(k==0)
                Current_Screen[j]=0xFF;
                else
                Current_Screen[j]=0x00;
        }
    i=i+128;
        for(j=i;j<i+7;j++){
            if(k==0)
                    Current_Screen[j]=0xFF;
                    else
                    Current_Screen[j]=0x00;
            }
        i=i+128;
                for(j=i;j<i+7;j++){
                    if(k==0)
                            Current_Screen[j]=0xFF;
                            else
                            Current_Screen[j]=0x00;
                 }
}

//
// new function
//
Uint8* battary_draw(int i,int k){
    unsigned int j;
    const Uint8 Oledx[]={
                         0x00, 0x00, 0x00, 0x00, 0x00, 0x00, 0x00, 0x00, 0x00, 0x00, 0x00, 0x00, 0x00, 0x00, 0x00, 0x00,
                         0x00, 0x00, 0x00, 0x00, 0x00, 0x00, 0x00, 0x00, 0x00, 0x00, 0x00, 0x00, 0x00, 0x00, 0x00, 0x00,
                         0x00, 0x00, 0x00, 0x00, 0x00, 0x00, 0x00, 0x00, 0x00, 0x00, 0x00, 0x00, 0x00, 0x00, 0x00, 0x00,
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                         0x00, 0x00, 0x00, 0x00, 0x00, 0x00, 0x00, 0x00, 0x00, 0x00, 0x00, 0x00, 0x00, 0x00, 0x00, 0x00
                         };
    if(k==0){
        for(j=0;j<1024;j++)
           Current_Screen[j]=Oledx[j];
    }else{
        for(j=0;j<1024;j++)
                   Current_Screen[j]=Byte_Invert(Oledx[j]);
    }
        if(i>0)
            Update_battry_percent(23,k);
        if(i>1)
             Update_battry_percent(31,k);
        if(i>2)
               Update_battry_percent(39,k);
        if(i>3)
              Update_battry_percent(47,k);
        if(i>4)
               Update_battry_percent(55,k);
        if(i>5)
                Update_battry_percent(63,k);
        if(i>6)
            Update_battry_percent(71,k);
        if(i>7)
            Update_battry_percent(79,k);
        if(i>8)
            Update_battry_percent(87,k);
        if(i>9)
            Update_battry_percent(95,k);
        Current_Screen_ptr=&Current_Screen[0];
    return Current_Screen_ptr;
}
//
///
//
Uint8* blank_draw(){
    unsigned int j;
    for(j=0;j<1024;j++)
               Current_Screen[j]=0xFF;
    Current_Screen_ptr=&Current_Screen[0];
        return Current_Screen_ptr;
}
//
//new for shoot
//
void battary_charge(){

}
//
// new function
//

//
//*********************************************************************************************
//Function Name    : void Home_var1(unsigned int i)
//No.Of Parameters : 1
//Parameters Type  : unsigned int
//Return Type      : void
//Description      : To draw the variable one on the main screen
//**********************************************************************************************
//
void Home_var1(unsigned int i){
    Uint8 j=0,k=0;
    j=i/60;
    k=i%60;
    Top_line_Update(1,20,j/10);
    Top_line_Update(1,25,j%10);
    Top_line_Update(1,33,k/10);
    Top_line_Update(1,38,k%10);
}
//
//*********************************************************************************************
//Function Name    : void Home_var2(unsigned int i)
//No.Of Parameters : 1
//Parameters Type  : unsigned int
//Return Type      : void
//Description      : To draw the variable one on the main screen
//**********************************************************************************************
//
void Home_var2(unsigned int i){
    Uint8 j=0,k=0;
    j=i/100;
    k=i%100;
    Top_line_Update(1,50,j/10);
    Top_line_Update(1,55,j%10);
    Top_line_Update(1,63,k/10);
}
//
//*********************************************************************************************
//Function Name    : void Home_var3(unsigned int i)
//No.Of Parameters : 1
//Parameters Type  : unsigned int
//Return Type      : void
//Description      : To draw the variable one on the main screen
//**********************************************************************************************
//
void Home_var3(unsigned int i){
    Uint8 j=0,k=0;
    if(i/10==10)
    Top_line_Update(1,85,1);
    j=i/10;
    if(j<10)
    Top_line_Update(1,90,j);
    else
     Top_line_Update(1,90,0);
    k=i%10;
    Top_line_Update(1,95,k);
}

//
//*********************************************************************************************
//Function Name    : void Home_var4(unsigned int i)
//No.Of Parameters : 1
//Parameters Type  : unsigned int
//Return Type      : void
//Description      : To draw the variable one on the main screen
//**********************************************************************************************
//
void Home_var4(Uint8 i){
fill_battary(i/10);
}

//
//*********************************************************************************************
//Function Name    : void fill_battary(Uint8 k)
//No.Of Parameters : 1
//Parameters Type  : unsigned int
//Return Type      : void
//Description      : To draw the variable one on the main screen
//**********************************************************************************************
//
void fill_battary(Uint8 k){
    Uint8 i=241,j=0;
    for(j=0;j<k;i++,j++){
                Current_Screen[i]=0x00;
            }
}

//
//*********************************************************************************************
//Function Name    : void Home_var5(float i)
//No.Of Parameters : 1
//Parameters Type  : unsigned int
//Return Type      : void
//Description      : To draw the variable one on the main screen
//**********************************************************************************************
//
void Home_var5(int i){
        bottom_line_Update(10,i/10);
        bottom_line_Update(15,i%10);
}

//
//*********************************************************************************************
//Function Name    : void Home_var6(float i)
//No.Of Parameters : 1
//Parameters Type  : unsigned int
//Return Type      : void
//Description      : To draw the variable one on the main screen
//**********************************************************************************************
//

void Home_var6(int i){
    bottom_line_Update(40,i/10);
    bottom_line_Update(45,i%10);
}
//
//*********************************************************************************************
//Function Name    : void Home_var7(float i)
//No.Of Parameters : 1
//Parameters Type  : unsigned int
//Return Type      : void
//Description      : To draw the variable one on the main screen
//**********************************************************************************************
//
void Home_var7(float i){
    unsigned int j,k;
    i=i*10;
    j=((i-273.15)*9/5)+32;
    if(j/100>0)
        bottom_line_Update(65,1);
    if(j/10<10)
        bottom_line_Update(70,j/10);
    else
    {
       k=j/10;
        bottom_line_Update(70,k%10);
    }
        bottom_line_Update(75,j%10);
}


void min_update(unsigned int i){
    home_ptr.minutes=i;
}
void watt_hour_update(unsigned int i){
    home_ptr.watt_hour=i;

}
void percentage_update(unsigned int i){
    home_ptr.percentage=i;

}
void temp_update(unsigned int i){
    home_ptr.temp=i;
}
void inwatt_update(unsigned int i){
    home_ptr.in_watt=i;
}
void outwatt_update(unsigned int i){
    home_ptr.out_watt=i;
}

